// capybot — Carl Nintendo, a spin-to-ask capybara oracle for the Elecrow CrowPanel 2.1".
// Board: ESP32-S3 Dev Module, 16MB flash, OPI PSRAM, USB CDC On Boot=Enabled,
//        USB Mode=Hardware CDC and JTAG. ESP32 core 2.0.14.
//
// Ask Carl a yes/no question: spin the knob while you ask. His face spins with the
// dial; when you stop he goes dizzy, then thinks, then answers with a coin flip —
// YES = happy dance, NO = he turns around and wiggles his butt at you.
//
//   IDLE --spin--> SPINNING --stop--> DIZZY --> THINKING --> ANSWER(YES|NO) --> IDLE
//   (DIZZY / THINKING / ANSWER each last a random 500-2000 ms)
//
// Carl is drawn from real sprite art (carl_sprites.h, generated by tools/): the
// sprites are RLE-compressed RGB565, decoded into PSRAM at boot and blitted into
// the double-buffered canvas. The spin is a live rotozoom so it tracks the knob.
//
// Flash: first upload each session needs the BOOT+RESET bootloader dance; tap RESET
//        after "Hard resetting via RTS pin". Re-uploads auto-reset.

#include <Arduino_GFX_Library.h>
#include <Wire.h>
#include <PCF8574.h>
#include <Adafruit_CST8XX.h>
#include <math.h>
#include "carl_sprites.h"

// ---------------------------------------------------------------------------
// Hardware pin map (board-specific — see project notes)
// ---------------------------------------------------------------------------
#define BKL_PIN    6
#define I2C_SDA    38
#define I2C_SCL    39
#define ENC_A      42
#define ENC_B      4
#define PCF_ADDR   0x21
#define TOUCH_ADDR 0x15
#define CX         240
#define CY         240

// C_BG MUST equal the rgb the sprites were flattened over (74,110,105) so their
// baked-in background matches the screen and edges stay seamless.
#define BG_R 74
#define BG_G 110
#define BG_B 105

Arduino_ESP32RGBPanel *bus = new Arduino_ESP32RGBPanel(
  16, 2, 1, 40, 7, 15, 41,
  46, 3, 8, 18, 17,
  14, 13, 12, 11, 10, 9,
  5, 45, 48, 47, 21);
Arduino_ST7701_RGBPanel *panel = new Arduino_ST7701_RGBPanel(
  bus, GFX_NOT_DEFINED, 0, false,
  480, 480, st7701_type5_init_operations, sizeof(st7701_type5_init_operations),
  true, 10, 4, 20, 10, 4, 20);
Arduino_Canvas *gfx = new Arduino_Canvas(480, 480, panel);

PCF8574 pcf8574(PCF_ADDR);
Adafruit_CST8XX tsPanel = Adafruit_CST8XX();
bool touchOK = false;

uint16_t C_BG, C_HEART, C_DOT;
uint16_t C_POOP, C_POOP_SH, C_PWHITE, C_PDARK;

#define FLASH_N 6
uint16_t FLASH[FLASH_N];   // drumroll colors cycled behind Carl while he thinks

uint16_t *sprBuf[SP_COUNT];   // decoded sprites in PSRAM
uint16_t *rotBuf = nullptr;   // 480x480 scratch for the spin rotozoom

enum Mode { IDLE, SPINNING, DIZZY, THINKING, ANSWER_YES, ANSWER_NO, SPLASH };

// ---------------------------------------------------------------------------
// Encoder — quadrature decoded in an ISR so we never miss a step
// ---------------------------------------------------------------------------
volatile int32_t encDelta = 0;
void IRAM_ATTR encISR() {
  bool a = digitalRead(ENC_A);
  bool b = digitalRead(ENC_B);
  encDelta += (a == b) ? 1 : -1;   // flip sign if spin direction feels backwards
}

// ---------------------------------------------------------------------------
// Interaction state
// ---------------------------------------------------------------------------
Mode     mode       = IDLE;
uint32_t phaseStart = 0;
uint32_t modeUntil  = 0;
uint32_t lastEncMs  = 0;
float    faceAngle  = 0.0f;
float    spinAccum  = 0.0f;
bool     swPrev     = false;
uint32_t pressStart = 0;
bool     longFired  = false;

const float    STEP     = 0.13f;   // radians of face spin per encoder count
const float    MIN_SPIN = 1.2f;    // must spin at least this much to count as a question
const uint32_t STOP_MS  = 250;     // knob idle this long => you've stopped spinning
const uint32_t LONG_MS  = 700;     // hold the knob this long => splash screen

uint32_t rdur() { return 500 + random(1501); }   // random 500..2000 ms

// ---------------------------------------------------------------------------
// Sprite decode + blitting
// ---------------------------------------------------------------------------
void decodeSprites() {
  for (int s = 0; s < SP_COUNT; s++) {
    const SpriteDef &d = CARL_SPRITES[s];
    sprBuf[s] = (uint16_t *)ps_malloc((size_t)d.w * d.h * 2);
    if (!sprBuf[s]) { Serial.printf("sprite %d alloc failed\n", s); continue; }
    uint32_t k = 0;
    for (uint32_t i = 0; i < d.words; i += 2) {
      uint16_t count = d.rle[i], val = d.rle[i + 1];
      while (count--) sprBuf[s][k++] = val;
    }
  }
  rotBuf = (uint16_t *)ps_malloc(480 * 480 * 2);
}

// Opaque blit of a sprite centered on screen (+ optional offset). fillScreen first
// so the ring outside the sprite (and any previous overlay) is cleared.
void blitCentered(int s, int dx, int dy) {
  const SpriteDef &d = CARL_SPRITES[s];
  gfx->fillScreen(C_BG);
  gfx->draw16bitRGBBitmap((480 - d.w) / 2 + dx, (480 - d.h) / 2 + dy, sprBuf[s], d.w, d.h);
}

// Blit a sprite centered over a solid `bg` color, keying out the sprite's own
// baked background (pixels == C_BG) so `bg` shows through behind Carl. Composed
// in rotBuf then blitted in one pass.
void blitCenteredKeyed(int s, int dx, int dy, uint16_t bg) {
  const SpriteDef &d = CARL_SPRITES[s];
  int ox = (480 - d.w) / 2 + dx, oy = (480 - d.h) / 2 + dy;
  for (int i = 0; i < 480 * 480; i++) rotBuf[i] = bg;
  for (int y = 0; y < d.h; y++) {
    int py = oy + y;
    if (py < 0 || py >= 480) continue;
    const uint16_t *row = &sprBuf[s][y * d.w];
    uint16_t *dst = &rotBuf[py * 480 + ox];
    for (int x = 0; x < d.w; x++) {
      int px = ox + x;
      if (px < 0 || px >= 480) continue;
      uint16_t v = row[x];
      if (v != C_BG) dst[x] = v;   // keep Carl; leave bg showing elsewhere
    }
  }
  gfx->draw16bitRGBBitmap(0, 0, rotBuf, 480, 480);
}

// Rotozoom a sprite about screen center by `ang`, into rotBuf, then blit. Pixels
// outside the source read C_BG so the whole frame is covered in one pass.
void blitRotated(int s, float ang, int dx, int dy) {
  const SpriteDef &d = CARL_SPRITES[s];
  int sw = d.w, sh = d.h, scx = sw / 2, scy = sh / 2;
  uint16_t *src = sprBuf[s];
  float cs = cosf(-ang), sn = sinf(-ang);
  int idx = 0;
  for (int y = 0; y < 480; y++) {
    float uy = y - CY - dy;
    for (int x = 0; x < 480; x++) {
      float ux = x - CX - dx;
      int sx = (int)lroundf(ux * cs - uy * sn) + scx;
      int sy = (int)lroundf(ux * sn + uy * cs) + scy;
      rotBuf[idx++] = (sx >= 0 && sx < sw && sy >= 0 && sy < sh) ? src[sy * sw + sx] : C_BG;
    }
  }
  gfx->draw16bitRGBBitmap(0, 0, rotBuf, 480, 480);
}

void drawHeart(int x, int y, int s, uint16_t c) {
  gfx->fillCircle(x - s / 2, y - s / 4, s / 2, c);
  gfx->fillCircle(x + s / 2, y - s / 4, s / 2, c);
  gfx->fillTriangle(x - s, y - s / 6, x + s, y - s / 6, x, y + s, c);
}

// A little emoji-style swirl poop, base at (cx, by). `lean` tilts the upper
// tiers sideways so it can jiggle while dancing.
void drawPoop(int cx, int by, int lean) {
  int xb = cx;                     // bottom tier x
  int xm = cx + lean / 2;          // middle tier leans a bit
  int xt = cx + lean;              // top tier leans more
  int xp = cx + (lean * 13) / 10;  // tip leans most
  gfx->fillEllipse(xb + 3, by - 12, 34, 16, C_POOP_SH);   // ground shadow
  gfx->fillEllipse(xb, by - 14, 34, 16, C_POOP);          // bottom tier
  gfx->fillEllipse(xm, by - 30, 25, 14, C_POOP);          // middle tier
  gfx->fillEllipse(xt, by - 44, 16, 11, C_POOP);          // top tier
  gfx->fillTriangle(xp - 9, by - 47, xp + 9, by - 47, xp, by - 60, C_POOP);  // tip
  gfx->fillEllipse(xb - 6, by - 22, 14, 4, C_POOP_SH);    // swirl hints
  gfx->fillEllipse(xm + 5, by - 37, 10, 3, C_POOP_SH);
  // cute face on the middle tier
  gfx->fillCircle(xm - 8, by - 33, 4, C_PWHITE);
  gfx->fillCircle(xm + 8, by - 33, 4, C_PWHITE);
  gfx->fillCircle(xm - 8, by - 33, 2, C_PDARK);
  gfx->fillCircle(xm + 8, by - 33, 2, C_PDARK);
  for (int i = 0; i < 2; i++) {   // little smile (thickened)
    gfx->drawLine(xm - 6, by - 25 + i, xm, by - 22 + i, C_PDARK);
    gfx->drawLine(xm, by - 22 + i, xm + 6, by - 25 + i, C_PDARK);
  }
}

// ---------------------------------------------------------------------------
void setup() {
  Serial.begin(115200);
  pinMode(BKL_PIN, OUTPUT);
  analogWrite(BKL_PIN, 210);

  Wire.begin(I2C_SDA, I2C_SCL);
  pcf8574.pinMode(P0, OUTPUT);
  pcf8574.pinMode(P2, OUTPUT);
  pcf8574.pinMode(P3, OUTPUT);
  pcf8574.pinMode(P4, OUTPUT);
  pcf8574.pinMode(P5, INPUT_PULLUP);
  pcf8574.begin();
  pcf8574.digitalWrite(P3, HIGH); delay(100);
  pcf8574.digitalWrite(P4, HIGH); delay(100);
  pcf8574.digitalWrite(P4, LOW);  delay(120);
  pcf8574.digitalWrite(P4, HIGH); delay(120);
  pcf8574.digitalWrite(P0, HIGH); delay(100);
  pcf8574.digitalWrite(P0, LOW);  delay(120);
  pcf8574.digitalWrite(P0, HIGH); delay(120);
  pcf8574.digitalWrite(P2, HIGH); delay(120);

  gfx->begin();
  C_BG      = gfx->color565(BG_R, BG_G, BG_B);
  C_HEART   = gfx->color565(235, 90, 110);
  C_DOT     = gfx->color565(245, 245, 245);
  C_POOP    = gfx->color565(122, 82, 52);
  C_POOP_SH = gfx->color565(94, 60, 36);
  C_PWHITE  = gfx->color565(250, 250, 250);
  C_PDARK   = gfx->color565(30, 24, 20);
  FLASH[0]  = gfx->color565(230, 60, 60);    // red
  FLASH[1]  = gfx->color565(240, 150, 40);   // orange
  FLASH[2]  = gfx->color565(240, 220, 60);   // yellow
  FLASH[3]  = gfx->color565(70, 200, 90);    // green
  FLASH[4]  = gfx->color565(70, 160, 235);   // blue
  FLASH[5]  = gfx->color565(180, 90, 220);   // purple

  gfx->fillScreen(C_BG);
  gfx->flush();
  decodeSprites();

  touchOK = tsPanel.begin(&Wire, TOUCH_ADDR);
  Serial.println(touchOK ? "Touch OK @0x15" : "No touch @0x15 (CST328 board rev?)");

  pinMode(ENC_A, INPUT);
  pinMode(ENC_B, INPUT);
  attachInterrupt(digitalPinToInterrupt(ENC_A), encISR, CHANGE);
  randomSeed(esp_random());

  blitCentered(SP_NEUTRAL, 0, 0);
  gfx->flush();
}

// ---------------------------------------------------------------------------
void loop() {
  uint32_t now = millis();

  // --- Encoder ---
  int32_t d = 0;
  if (encDelta != 0) { noInterrupts(); d = encDelta; encDelta = 0; interrupts(); }
  if (d != 0) {
    faceAngle += d * STEP;
    lastEncMs  = now;
    if (mode == IDLE) { mode = SPINNING; phaseStart = now; spinAccum = 0; }
    if (mode == SPINNING) spinAccum += fabsf(d * STEP);
  }

  // --- Knob button: short tap = ask again (from idle); long hold = splash ---
  bool swNow = (pcf8574.digitalRead(P5, true) == LOW);
  if (swNow && !swPrev) {                        // pressed down
    pressStart = now;
    longFired  = false;
  }
  if (swNow && !longFired && (now - pressStart) >= LONG_MS) {   // held long enough
    longFired = true;
    mode = SPLASH; phaseStart = now; faceAngle = 0;
  }
  if (!swNow && swPrev) {                         // released
    if (longFired) {
      mode = IDLE; faceAngle = 0;                 // leave the splash
    } else if ((now - pressStart) >= 40 && mode == IDLE) {
      mode = DIZZY; phaseStart = now; modeUntil = now + rdur(); faceAngle = 0;  // ask again
    }
  }
  swPrev = swNow;

  // --- Touch: idle petting flavor ---
  bool petting = false; int petX = 0, petY = 0;
  if (mode == IDLE && touchOK && tsPanel.touched()) {
    CST_TS_Point p = tsPanel.getPoint(0);
    petting = true; petX = p.x; petY = p.y;
  }

  // --- Transitions ---
  switch (mode) {
    case SPINNING:
      if (now - lastEncMs > STOP_MS) {
        if (spinAccum > MIN_SPIN) { mode = DIZZY; phaseStart = now; modeUntil = now + rdur(); }
        else { mode = IDLE; faceAngle = 0; }
      }
      break;
    case DIZZY:
      if (now >= modeUntil) { mode = THINKING; phaseStart = now; modeUntil = now + rdur() + 2000; }
      break;
    case THINKING:
      if (now >= modeUntil) {
        phaseStart = now;
        if (random(2) == 0) { mode = ANSWER_NO;  modeUntil = now + 3800 + random(1200); } // plop + a few-sec duet
        else                { mode = ANSWER_YES; modeUntil = now + rdur(); }
      }
      break;
    case ANSWER_YES:
    case ANSWER_NO:
      if (now >= modeUntil) { mode = IDLE; faceAngle = 0; }
      break;
    default: break;
  }

  // --- Render ---
  uint32_t ph = now - phaseStart;
  int16_t  breath = (int16_t)lroundf(5.0f * sinf(now / 650.0f));

  switch (mode) {
    case SPINNING:
      blitRotated(SP_NEUTRAL, faceAngle, 0, 0);
      break;

    case DIZZY: {
      float wob = 0.18f * sinf(ph * 0.02f);
      int16_t bob = (int16_t)(4.0f * sinf(ph * 0.03f));
      blitRotated(SP_DIZZY, wob, 0, bob);
      break;
    }

    case THINKING: {
      uint16_t fc = FLASH[(ph / 150) % FLASH_N];   // drumroll: swap bg every 150ms
      blitCenteredKeyed(SP_THINKING, 0, breath, fc);
      int total = modeUntil - phaseStart;
      int dots = 1 + (total > 0 ? (int)(3.0f * ph / total) : 0);
      if (dots > 3) dots = 3;
      for (int i = 0; i < dots; i++) gfx->fillCircle(300 + i * 24, 108 - i * 10, 7, C_DOT);
      break;
    }

    case ANSWER_YES: {
      float rock = 0.16f * sinf(ph * 0.02f);
      int16_t hop = -(int16_t)(16.0f * fabsf(sinf(ph * 0.02f)));
      blitRotated(SP_HAPPY, rock, 0, hop);
      if ((ph / 220) % 2 == 0) { drawHeart(120, 150, 20, C_HEART); drawHeart(360, 150, 20, C_HEART); }
      break;
    }

    case ANSWER_NO: {
      const uint32_t PLOP_END = 550;   // reveal + plop, then the two of them dance
      if (ph < PLOP_END) {
        int dx = (int)(22.0f * sinf(ph * 0.025f));   // butt turn-and-wiggle
        blitCentered(SP_BUTT, dx, 0);
        if (ph > 200) {                              // poop drops in and settles
          float pt = (ph - 200) / 300.0f; if (pt > 1.0f) pt = 1.0f;
          int drop = (int)((1.0f - pt) * (1.0f - pt) * -70);
          drawPoop(CX, 458 + drop, 0);
        }
      } else {
        uint32_t t2 = ph - PLOP_END;                 // Carl + poop dance together
        int sway    = (int)(18.0f * sinf(t2 * 0.008f));                    // sway toward/apart
        int carlHop = (int)(14.0f * fabsf(sinf(t2 * 0.012f)));             // Carl bounces...
        int poopHop = (int)(14.0f * fabsf(sinf(t2 * 0.012f + 3.14159f)));  // ...poop on the offbeat
        int lean    = (int)(10.0f * sinf(t2 * 0.02f));                     // poop jiggles
        blitCentered(SP_BUTT, sway, -carlHop);
        drawPoop(CX - (int)(sway * 0.7f), 458 - poopHop, lean);
      }
      break;
    }

    case SPLASH: {
      blitCentered(SP_NEUTRAL, 0, -36);          // Carl, nudged up to make room
      gfx->drawCircle(CX, CY, 236, C_DOT);       // thin decorative border
      gfx->drawCircle(CX, CY, 232, C_DOT);
      const char *title = "Carl Nintendo";
      const char *sub   = "the capybara oracle";
      // title (size 3) with a drop shadow for legibility over Carl
      gfx->setTextSize(3);
      int tw = (int)strlen(title) * 6 * 3;
      gfx->setTextColor(C_PDARK);
      gfx->setCursor(CX - tw / 2 + 2, 396 + 2); gfx->print(title);
      gfx->setTextColor(C_PWHITE);
      gfx->setCursor(CX - tw / 2, 396);          gfx->print(title);
      // subtitle (size 2)
      gfx->setTextSize(2);
      int sw = (int)strlen(sub) * 6 * 2;
      gfx->setTextColor(C_PDARK);
      gfx->setCursor(CX - sw / 2 + 1, 430 + 1);  gfx->print(sub);
      gfx->setTextColor(C_PWHITE);
      gfx->setCursor(CX - sw / 2, 430);          gfx->print(sub);
      break;
    }

    case IDLE:
    default:
      if (petting) {
        blitCentered(SP_HAPPY, 0, breath);
        drawHeart(petX, petY, 18, C_HEART);
      } else {
        blitCentered(SP_NEUTRAL, 0, breath);
      }
      break;
  }

  gfx->flush();
  delay(16);
}
